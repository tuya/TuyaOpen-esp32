## Kconfig
```kconfig
menu "configure esp32"

    config PLATFORM_ESP32
        bool
        default y

    config ENABLE_PLATFORM_MBEDTLS
        bool
        default y
        
    config OPERATING_SYSTEM
        int
        default 98
        ---help---
            100     /* LINUX */
            98      /* RTOS */        
            3       /* Non-OS */

    config ENABLE_WIFI
        bool "ENABLE_WIFI --- use wifi to connect"
        default y

    config ENABLE_BLUETOOTH
        bool "ENABLE_BLUETOOTH --- use bluetooth to connect"
        select ENABLE_BT_SERVICE
        select ENABLE_NIMBLE
        default y

    config ENABLE_ADC
        bool "ENABLE_ADC --- use adc"
        default y

    config ENABLE_GPIO
        bool "ENABLE_GPIO --- use gpio"
        default y

    config ENABLE_PWM
        bool "ENABLE_PWM --- use pwm"
        default y

    config ENABLE_I2C
        bool "ENABLE_SW_I2C --- use software i2c"
        default y

    config ENABLE_SPI
        bool "ENABLE_SPI --- use spi"
        default y

    config ENABLE_TIMER
        bool "ENABLE_TIMER --- use timer"
        default y

    config ENABLE_WATCHDOG
        bool "ENABLE_WATCHDOG --- use watchdog"
        default y

    config LITTLE_END
        int
        default 1
        ---help---
            0       /* big endian */
            1       /* little endian */

    endmenu
```

## tuya_open_sdk/sdkconfig.defaults.esp32p4
```kconfig
# ESP32-P4 + ESP32-C6 hosted WiFi via SDIO (Waveshare ESP32-P4-WIFI6)
# Use esp_hosted 1.4.x component defaults for all SDIO/reset settings:
#   GPIO54 reset (default for P4+C6), ACTIVE_HIGH (reset pulse: HIGH->LOW->HIGH,
#   final state HIGH = CHIP_PU HIGH = C6 running), streaming mode ON
CONFIG_SLAVE_IDF_TARGET_ESP32C6=y

CONFIG_WIFI_RMT_STATIC_RX_BUFFER_NUM=16
CONFIG_WIFI_RMT_DYNAMIC_RX_BUFFER_NUM=64
CONFIG_WIFI_RMT_DYNAMIC_TX_BUFFER_NUM=64
CONFIG_WIFI_RMT_AMPDU_TX_ENABLED=y
CONFIG_WIFI_RMT_TX_BA_WIN=32
CONFIG_WIFI_RMT_AMPDU_RX_ENABLED=y
CONFIG_WIFI_RMT_RX_BA_WIN=32

CONFIG_LWIP_TCP_SND_BUF_DEFAULT=65534
CONFIG_LWIP_TCP_WND_DEFAULT=65534
CONFIG_LWIP_TCP_RECVMBOX_SIZE=64
CONFIG_LWIP_UDP_RECVMBOX_SIZE=64
CONFIG_LWIP_TCPIP_RECVMBOX_SIZE=64
CONFIG_LWIP_TCP_SACK_OUT=y

# Flash & partition table (32MB NOR Flash)
CONFIG_ESPTOOLPY_FLASHSIZE_32MB=y
CONFIG_ESPTOOLPY_FLASHSIZE="32MB"
CONFIG_PARTITION_TABLE_CUSTOM_FILENAME="partitions_32M.csv"
CONFIG_PARTITION_TABLE_FILENAME="partitions_32M.csv"

# PSRAM (32MB OPI, W32X package)
CONFIG_SPIRAM=y
CONFIG_SPIRAM_MODE_OCT=y
CONFIG_SPIRAM_SPEED_200M=y
CONFIG_SPIRAM_FETCH_INSTRUCTIONS=y
CONFIG_SPIRAM_RODATA=y
```
